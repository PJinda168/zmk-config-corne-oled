#include <dt-bindings/zmk/matrix_transform.h>

 / {
    chosen {
        zmk,kscan = &kscan;
    };

    kscan: kscan_0 {
        compatible = "zmk,kscan-gpio-matrix";
        row-gpios = <&gpio0 0 (GPIO_PULL_UP | GPIO_ACTIVE_LOW)>,
                    <&gpio0 1 (GPIO_PULL_UP | GPIO_ACTIVE_LOW)>,
                    <&gpio0 2 (GPIO_PULL_UP | GPIO_ACTIVE_LOW)>;
        col-gpios = <&gpio1 0 (GPIO_ACTIVE_LOW)>,
                    <&gpio1 1 (GPIO_ACTIVE_LOW)>,
                    <&gpio1 2 (GPIO_ACTIVE_LOW)>;
    };

    matrix_transform {
        compatible = "zmk,matrix-transform";
        rows = <3>;
        columns = <3>;
        map = < 0 1 2
                3 4 5
                6 7 8 >;
    };
};
